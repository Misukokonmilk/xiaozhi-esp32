## main/Kconfig.projbuild
```kconfig
menu "Xiaozhi Assistant"

    # 已移除OTA相关配置
    help
        The application will access this URL to check for new firmwares and server address.

choice
    prompt "Flash Assets"
    default FLASH_DEFAULT_ASSETS
    help
        Select the assets to flash.

    config FLASH_NONE_ASSETS
        bool "Do not flash assets"
    config FLASH_DEFAULT_ASSETS
        bool "Flash Default Assets"
    config FLASH_CUSTOM_ASSETS
        bool "Flash Custom Assets"
endchoice

config CUSTOM_ASSETS_FILE
    depends on FLASH_CUSTOM_ASSETS
    string "Custom Assets File"
    default "assets.bin"
    help
        The custom assets file to flash.
        It can be a local file relative to the project directory or a remote url.

choice
    prompt "Default Language"
    default LANGUAGE_ZH_CN
    help
        Select device display language

    config LANGUAGE_ZH_CN
        bool "Chinese"
    config LANGUAGE_ZH_TW
        bool "Chinese Traditional"
    config LANGUAGE_EN_US
        bool "English"
    config LANGUAGE_JA_JP
        bool "Japanese"
    config LANGUAGE_KO_KR
        bool "Korean"
    config LANGUAGE_VI_VN
        bool "Vietnamese"
    config LANGUAGE_TH_TH
        bool "Thai"
    config LANGUAGE_DE_DE
        bool "German"
    config LANGUAGE_FR_FR
        bool "French"
    config LANGUAGE_ES_ES
        bool "Spanish"
    config LANGUAGE_IT_IT
        bool "Italian"
    config LANGUAGE_RU_RU
        bool "Russian"
    config LANGUAGE_AR_SA
        bool "Arabic"
    config LANGUAGE_HI_IN
        bool "Hindi"
    config LANGUAGE_PT_PT
        bool "Portuguese"
    config LANGUAGE_PL_PL
        bool "Polish"
    config LANGUAGE_CS_CZ
        bool "Czech"
    config LANGUAGE_FI_FI
        bool "Finnish"
    config LANGUAGE_TR_TR
        bool "Turkish"
    config LANGUAGE_ID_ID
        bool "Indonesian"
    config LANGUAGE_UK_UA
        bool "Ukrainian"
    config LANGUAGE_RO_RO
        bool "Romanian"
endchoice

choice BOARD_TYPE
    prompt "Board Type"
    default BOARD_TYPE_ECHOEAR
    help
        Board type. 开发板类型

    config BOARD_TYPE_ECHOEAR
        bool "EchoEar"
        depends on IDF_TARGET_ESP32S3
endchoice

choice DISPLAY_STYLE
    prompt "Select display style"
    default USE_DEFAULT_MESSAGE_STYLE
    help
        Select display style for Xiaozhi device

    config USE_DEFAULT_MESSAGE_STYLE
        bool "Enable default message style"

    config USE_WECHAT_MESSAGE_STYLE
        bool "Enable WeChat Message Style"

    config USE_EMOTE_MESSAGE_STYLE
        bool "Emote animation style"
        depends on BOARD_TYPE_ESP_BOX_3 || BOARD_TYPE_ECHOEAR
endchoice

config USE_ESP_WAKE_WORD
    bool "Enable Wake Word Detection (without AFE)"
    default n
    depends on IDF_TARGET_ESP32C3 || IDF_TARGET_ESP32C5 || IDF_TARGET_ESP32C6 || (IDF_TARGET_ESP32 && SPIRAM)
    help
        支持 ESP32 C3、ESP32 C5 与 ESP32 C6，增加ESP32支持（需要开启PSRAM）

config USE_AFE_WAKE_WORD
    bool "Enable Wake Word Detection (AFE)"
    default y
    depends on (IDF_TARGET_ESP32S3 || IDF_TARGET_ESP32P4) && SPIRAM
    help
        需要 ESP32 S3 与 PSRAM 支持

config USE_CUSTOM_WAKE_WORD
    bool "Enable Custom Wake Word Detection"
    default n
    depends on (IDF_TARGET_ESP32S3 || IDF_TARGET_ESP32P4) && SPIRAM && (!USE_AFE_WAKE_WORD)
    help
        需要 ESP32 S3 与 PSRAM 支持
        
config CUSTOM_WAKE_WORD
    string "Custom Wake Word"
    default "xiao tu dou"
    depends on USE_CUSTOM_WAKE_WORD
    help
        自定义唤醒词，中文用拼音表示，每个字之间用空格隔开

config CUSTOM_WAKE_WORD_DISPLAY
    string "Custom Wake Word Display"
    default "小土豆"
    depends on USE_CUSTOM_WAKE_WORD
    help
        唤醒后发送给服务器的问候语 

config CUSTOM_WAKE_WORD_THRESHOLD
    int "Custom Wake Word Threshold (%)"
    default 20
    range 1 99
    depends on USE_CUSTOM_WAKE_WORD
    help
        自定义唤醒词阈值，范围1-99，越小越敏感，默认10

config USE_AUDIO_PROCESSOR
    bool "Enable Audio Noise Reduction"
    default y
    depends on (IDF_TARGET_ESP32S3 || IDF_TARGET_ESP32P4) && SPIRAM
    help
        需要 ESP32 S3 与 PSRAM 支持

config USE_DEVICE_AEC
    bool "Enable Device-Side AEC"
    default n
    depends on USE_AUDIO_PROCESSOR && BOARD_TYPE_ECHOEAR
    help
        因为性能不够，不建议和微信聊天界面风格同时开启

config USE_SERVER_AEC
    bool "Enable Server-Side AEC (Unstable)"
    default n
    depends on USE_AUDIO_PROCESSOR
    help
        启用服务器端 AEC，需要服务器支持

config USE_AUDIO_DEBUGGER
    bool "Enable Audio Debugger"
    default n
    help
        启用音频调试功能，通过UDP发送音频数据

config USE_ACOUSTIC_WIFI_PROVISIONING
    bool "Enable Acoustic WiFi Provisioning"
    default n
    help
        启用声波配网功能，使用音频信号传输 WiFi 配置数据

config AUDIO_DEBUG_UDP_SERVER
    string "Audio Debug UDP Server Address"
    default "192.168.2.100:8000"
    depends on USE_AUDIO_DEBUGGER
    help
        UDP服务器地址，格式: IP:PORT，用于接收音频调试数据

config RECEIVE_CUSTOM_MESSAGE
    bool "Enable Custom Message Reception"
    default n
    help
        启用接收自定义消息功能，允许设备接收来自服务器的自定义消息（最好通过 MQTT 协议）

endmenu
```
